## boards/shields/boardsource3x4/kconfig.defconfig
```kconfig
if SHIELD_TUBETEST
    config ZMK_KEYBOARD_NAME
        default "boardsource4x4"
endif
```

## boards/shields/boardsource3x4/kconfig.shield
```kconfig
config SHIELD_BOARDSOURCE3X4
    def_bool $(shields_list_contains, boardsource3x4)

config ZMK_USB
    bool "Enable USB support"
    default y

config ZMK_USB_HID
    bool "Enable USB HID support"
    default y

config ZMK_LOGGING
    bool "Enable logging support"
    default y

config ZMK_LOG_LEVEL_DBG
    bool "Set log level to debug"
    default y
```

## config/boards/shields/boardsource3x4/Kconfig.defconfig
```kconfig
if SHIELD_BOARDSOURCE3X4
    config ZMK_KEYBOARD_NAME
        default "boardsource3x4"

    config ZMK_KSCAN_MATRIX
        default y
endif
```
