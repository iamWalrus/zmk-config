/ {
    chosen {
        zmk,kscan = &default_kscan;
    };

    default_kscan: kscan {
        compatible = "zmk,kscan-gpio-direct";
        label = "default_kscan";

        input-gpios = < 
            &pro_micro D6  (GPIO_ACTIVE_LOW | GPIO_PULL_UP)   // D0
            &pro_micro D8  (GPIO_ACTIVE_LOW | GPIO_PULL_UP)   // D1
            &pro_micro D17 (GPIO_ACTIVE_LOW | GPIO_PULL_UP)   // D2
            &pro_micro D20 (GPIO_ACTIVE_LOW | GPIO_PULL_UP)   // D3
            &pro_micro D22 (GPIO_ACTIVE_LOW | GPIO_PULL_UP)   // D4
            &pro_micro D24 (GPIO_ACTIVE_LOW | GPIO_PULL_UP)   // D5
            &pro_micro D10 (GPIO_ACTIVE_LOW | GPIO_PULL_UP)   // D6
            &pro_micro D11 (GPIO_ACTIVE_LOW | GPIO_PULL_UP)   // D7
            &pro_micro D4  (GPIO_ACTIVE_LOW | GPIO_PULL_UP)   // D8
            &pro_micro D9  (GPIO_ACTIVE_LOW | GPIO_PULL_UP)   // D10
            &pro_micro D7  (GPIO_ACTIVE_LOW | GPIO_PULL_UP)   // D11
        >;
    };
};
